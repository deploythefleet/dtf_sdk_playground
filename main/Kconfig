## main/Kconfig
```kconfig
menu "Deploy The Fleet SDK Playground"

    menu "WiFi"

        config DTF_PLAYGROUND_SSID
        string "SSID"
        default "YOUR_SSID"
        help
            The SSID of your WiFi network

        config DTF_PLAYGROUND_WIFI_PASSWORD
        string "Password"
        default "YOUR_PASSWORD"
        help
            The password to your WiFi network

    endmenu

    config DTF_PLAYGROUND_PRODUCT_ID
    string "DTF Product ID"
    help
        The product ID for this device from Deploy the Fleet
endmenu
```

## sdkconfig.defaults
```kconfig
CONFIG_IDF_TARGET="esp32"
#
# Custom Certificate for DTF Failover
#
CONFIG_MBEDTLS_CUSTOM_CERTIFICATE_BUNDLE=y
CONFIG_MBEDTLS_CUSTOM_CERTIFICATE_BUNDLE_PATH="components/dtf_sdk/certs/dtf_root_x1.pem"
```
